## boards/riscv/ch32v307v_evt/Kconfig.board
```kconfig
# Copyright (c) 2021, TODO
# SPDX-License-Identifier: Apache-2.0

config BOARD_CH32V307V_EVT
	bool "WCH CH32V307V-EVT"
	depends on SOC_CH32V307
```

## boards/riscv/ch32v307v_evt/Kconfig.defconfig
```kconfig
# Copyright (c) 2021 TODO
# SPDX-License-Identifier: Apache-2.0

if BOARD_CH32V307V_EVT

config BOARD
	default "ch32v307v_evt"

endif # BOARD_CH32V307V_EVT
```

## boards/riscv/ch32v307v_evt/ch32v307v_evt_defconfig
```kconfig
# Copyright (c) 2021, TODO
# SPDX-License-Identifier: Apache-2.0

CONFIG_SOC_SERIES_CH32V3X=y
CONFIG_SOC_CH32V307=y
CONFIG_BOARD_CH32V307V_EVT=y

CONFIG_GPIO=y
CONFIG_PINCTRL=y

CONFIG_SERIAL=y
CONFIG_CONSOLE=y
CONFIG_UART_CONSOLE=y
CONFIG_UART_INTERRUPT_DRIVEN=y

#CONFIG_SPI=n

CONFIG_NO_OPTIMIZATIONS=y
```

## drivers/clock_control/Kconfig.ch32
```kconfig
# Copyright (c)
# SPDX-License-Identifier: Apache-2.0

config CLOCK_CONTROL_CH32
	bool "CH32 clock control"
	default y
	depends on DT_HAS_WCH_CH32_RCC_ENABLED
	help
	  Enable driver for WCH CH32 Reset Clock Controller(RCC).
```

## drivers/gpio/Kconfig.ch32
```kconfig
# CH32 GPIO configuration options

# SPDX-License-Identifier: Apache-2.0

config GPIO_CH32
	bool "WCH CH32 GPIO driver"
	default y
	depends on DT_HAS_WCH_CH32_GPIO_ENABLED
	help
	  Enable the GPIO driver on WCH CH32 MCU boards
```

## drivers/pinctrl/Kconfig.ch32
```kconfig
# Copyright (c)
# SPDX-License-Identifier: Apache-2.0

config PINCTRL_CH32
	bool "Pin controller driver for WCH CH32 MCUs"
	default y
	depends on DT_HAS_WCH_CH32_PINCTRL_ENABLED
	help
	  Enable pin controller driver for WCH CH32 MCUs
```

## drivers/reset/Kconfig.ch32
```kconfig
# Copyright (c) 2022 Google Inc
# SPDX-License-Identifier: Apache-2.0

config RESET_CH32
	bool "CH32 Reset Controller Driver"
	default y
	depends on DT_HAS_WCH_CH32_RCTL_ENABLED
```

## drivers/serial/Kconfig.ch32
```kconfig
# Copyright (c)
# SPDX-License-Identifier: Apache-2.0

config UART_CH32
	bool "CH32 serial driver"
	default y
	depends on DT_HAS_WCH_CH32_UART_ENABLED
	select SERIAL_HAS_DRIVER
	select SERIAL_SUPPORT_INTERRUPT
	select USE_CH32_UART
	select RESET
	help
	  This option enables the USART driver for CH32 SoC family.
```

## drivers/spi/Kconfig.ch32
```kconfig
# Copyright (c) 
# SPDX-License-Identifier: Apache-2.0

config SPI_CH32
	bool "WCH CH32 SPI driver"
	default y
	depends on DT_HAS_WCH_CH32_SPI_ENABLED
	help
	  Enables WCH CH32 SPI driver.

if SPI_CH32

config SPI_CH32_INTERRUPT
	bool "CH32 MCU SPI Interrupt Support"
	default y if SPI_ASYNC
	default y if SPI_CH32_DMA
	help
	  Enable the interrupt driven mode for SPI instances

config SPI_CH32_DMA
	bool "CH32 MCU SPI DMA Support"
	select DMA
	select SPI_CH32_INTERRUPT
	help
	  Use the DMA for SPI transfer
	  that enable dma channels in their device tree node.

endif # SPI_CH32
```

## dts/bindings/clock/wch,ch32-rcc.yaml
```yaml
# Copyright (c)
# SPDX-License-Identifier: Apache-2.0

description: |
  CH32 MCU Reset and Clock Controller (RCC) if a multi-function peripheral in
  charge of reset control (RCTL) and clock control (CCTL) for all SoC
  peripherals. Child nodes are used to represent each functional block.

compatible: "wch,ch32-rcc"

include: [clock-controller.yaml, base.yaml]

properties:
  reg:
    required: true
  
  clocks:
    required: true

  clock-frequency:
    required: true
    type: int
    description: |
      default frequency in Hz for clock output

  ahb-prescaler:
    type: int
    required: true
    enum:
      - 1
      - 2
      - 4
      - 8
      - 16
      - 64
      - 128
      - 256
      - 512
    description: |
        AHB prescaler. Defines actual core clock frequency (HCLK)
        based on system frequency input.
        The HCLK clocks CPU, AHB, memories and DMA.

  apb1-prescaler:
    type: int
    required: true
    enum:
      - 1
      - 2
      - 4
      - 8
      - 16

  apb2-prescaler:
    type: int
    required: true
    enum:
      - 1
      - 2
      - 4
      - 8
      - 16
```

## dts/bindings/cpu/wch,qingke.yaml
```yaml
# Copyright (c)
# SPDX-License-Identifier: Apache-2.0

description: WCH QingKe RISC-V Core

compatible: "wch,qingke"

include: riscv,cpus.yaml
```

## dts/bindings/flash_controller/wch,ch32-flash-controller.yaml
```yaml
# Copyright (c)
# SPDX-License-Identifier: Apache-2.0

description: |
  CH32 Flash memory controller
  Fast programming: The page operation mode (Recommended) is used for 
  this method. After unlocking in a specific sequence, 
  a single 256-byte programming and 256-byte erasing are performed, 
  32K-byte erasing,64K-byte erasing and whole chip erasure are performed

compatible: "wch,ch32-flash-controller"

include: flash-controller.yaml
```

## dts/bindings/gpio/wch,ch32-gpio.yaml
```yaml
# Copyright (c)
# SPDX-License-Identifier: Apache-2.0

description: CH32 GPIO node

compatible: "wch,ch32-gpio"

include: [gpio-controller.yaml, reset-device.yaml, base.yaml]

properties:
  reg:
    required: true

  clocks:
    required: true
  
  resets:
    required: true

  "#gpio-cells":
    const: 2

gpio-cells:
  - pin
  - flags
```

## dts/bindings/interrupt-controller/wch,pfic.yaml
```yaml
# Copyright (c) 2021, Tokita, Hiroshi
# SPDX-License-Identifier: Apache-2.0

description: QingKe Programmable Fast Interrupt Controller

compatible: "wch,pfic"

include: [interrupt-controller.yaml, base.yaml]

properties:
  reg:
    required: true

  "#interrupt-cells":
    const: 2

interrupt-cells:
  - irq
  - priority
```

## dts/bindings/mtd/wch,ch32-nv-flash.yaml
```yaml
# Copyright (c)
# SPDX-License-Identifier: Apache-2.0

description: |
  Flash memory & controller binding of CH32

include: soc-nv-flash.yaml

compatible: wch,ch32-nv-flash

properties:
  max-erase-time-ms:
    type: int
    required: true
    description: Max erase time(millisecond) of a flash page

  page-size:
    type: int
    required: true
    description: Flash memory page size

  write-block-size:
    type: int
    required: true
    description: Flash memory a single programming size
```

## dts/bindings/pinctrl/wch,ch32-pinctrl.yaml
```yaml
# Copyright (c)
# SPDX-License-Identifier: Apache-2.0

description: |
    The CH32 pin controller (AFIO Model) is a singleton node responsible for
    controlling pin function selection and pin properties. For example, you can
    use this node to route USART1 RX to pin PA10 and enable the pull-up resistor
    on the pin. Remapping is also supported.

    The node has the 'pinctrl' node label set in your SoC's devicetree,
    so you can modify it like this:

      &pinctrl {
              /* your modifications go here */
      };
compatible: "wch,ch32-pinctrl"

include: base.yaml

child-binding:
  child-binding:
    properties:
      pinmux:
        required: true
        type: array
        description: |
          An array of pins sharing the same group properties. The pins should
          be defined using pre-defined macros or, alternatively, using the
          CH32_PINMUX_AF utility macros depending on the pinmux model used by 
          the SoC series.
      
      remapping:
        type: int
        default: 0
        description: |
          Set Alternate function remapping confiuration, Bit0~3, AFIO_PCFR1~2 
          registers offsets, Bit4~7, remapping configuration values, Bit15~8
          remapping bits offset in the registers.

      slew-rate:
        type: string
        default: "max-speed-10mhz"
        enum:
          - "max-speed-10mhz"
          - "max-speed-2mhz"
          - "max-speed-50mhz"
        description: |
          Set the maximum speed of a pin. This setting effectively limits the
          slew rate of the output signal. Defaults to "max-speed-10mhz".
```

## dts/bindings/reset/wch,ch32-rctl.yaml
```yaml
# Copyright (c) 2022, Teslabs Engineering S.L.
# SPDX-License-Identifier: Apache-2.0

description: |
  CH32 Reset and Clock Control (RCC) node.
  This node is in charge of reset control for AHB (Advanced High Performance)
  and APB (Advanced Peripheral) bus domains.

  To specify the reset line in a peripheral, the standard resets property needs
  to be used, e.g.:

    usart1: serial@xxx {
        ...
        /* Cell contains information about RCU register offset and bit */
        resets = <&rctl CH32_RESET(ABP2, 4U)>;
        ...
    };

compatible: "wch,ch32-rctl"

include: [reset-controller.yaml, base.yaml]

properties:
  "#reset-cells":
    const: 1

  set-bit-to-deassert:
    type: boolean
    description: |
      Indicates if the driver should set bit in clear register to
      deassert reset.

reset-cells:
  - id
```

## dts/bindings/serial/wch,ch32-uart.yaml
```yaml
# Copyright (c)
# SPDX-License-Identifier: Apache-2.0

description: WCH CH32 USART

compatible: "wch,ch32-uart"

include: [uart-controller.yaml, reset-device.yaml, pinctrl-device.yaml]

properties:
  reg:
    required: true

  clocks:
    required: true

  resets:
    required: true

  interrupts:
    required: true

  pinctrl-0:
    required: true

  pinctrl-names:
    required: true

  single-wire:
    type: boolean
    description: |
      Enable the single wire half-duplex communication.
      Using this mode, TX and RX lines are internally connected and
      only TX pin is used afterwards and should be configured.
      RX/TX conflicts must be handled on user side.

  fifo-enable:
    type: boolean
    description: |
      Enables transmit and receive FIFO using default FIFO configuration (typically threshold is
      set to 1/8).
      In TX, FIFO allows to work in burst mode, easing scheduling of loaded applications. It also
      allows more reliable communication with UART devices sensitive to variation of inter-frames
      delays.
      In RX, FIFO reduces overrun occurrences.
```

## dts/bindings/timer/wch,systimer.yaml
```yaml
# Copyright (c) 2021 TOKITA Hiroshi <tokita.hiroshi@gmail.com>
# SPDX-License-Identifier: Apache-2.0

description: |
  QingKe System Timer

  The QingKe system timer provides RISC-V privileged mtime and mtimecmp
  registers.

compatible: "wch,systimer"

include: base.yaml

properties:
  reg:
    required: true

  interrupts:
    required: true
```

## modules/hal_wch/Kconfig
```kconfig
# Copyright (c)
# SPDX-License-Identifier: Apache-2.0

config ZEPHYR_HAL_WCH_MODULE
	bool

config HAS_CH32_HAL
	bool
	select HAS_CMSIS_CORE if ARM

if HAS_CH32_HAL

config USE_CH32_UART
	bool

endif # HAS_CH32_HAL
```

## soc/riscv/wch_ch32/Kconfig
```kconfig
# Copyright (c)
# SPDX-License-Identifier: Apache-2.0

config SOC_FAMILY_CH32
	bool

if SOC_FAMILY_CH32

config SOC_FAMILY
	string
	default "wch_ch32"

config KERNEL_ENTRY
	default "__ch32_entry"

source "soc/riscv/wch_ch32/*/Kconfig.soc"

endif # SOC_FAMILY_CH32
```

## soc/riscv/wch_ch32/Kconfig.defconfig
```kconfig
# Copyright (c) 
# SPDX-License-Identifier: Apache-2.0

source "soc/riscv/wch_ch32/*/Kconfig.defconfig.series"
```

## soc/riscv/wch_ch32/ch32v3x/Kconfig.defconfig.ch32v303
```kconfig
# Copyright (c) 
# SPDX-License-Identifier: Apache-2.0

if SOC_CH32V303

config SOC
	default "ch32v303"

endif # SOC_CH32V303
```

## soc/riscv/wch_ch32/ch32v3x/Kconfig.defconfig.ch32v305
```kconfig
# Copyright (c) 
# SPDX-License-Identifier: Apache-2.0

if SOC_CH32V305

config SOC
	default "ch32v305"

endif # SOC_CH32V305
```

## soc/riscv/wch_ch32/ch32v3x/Kconfig.defconfig.ch32v307
```kconfig
# Copyright (c) 
# SPDX-License-Identifier: Apache-2.0

if SOC_CH32V307

config SOC
	default "ch32v307"

endif # SOC_CH32V307
```
