/*
 * Copyright
 *
 * SPDX-License-Identifier: Apache-2.0
 */

 #include <wch/ch32v3x.dtsi>
 
 / {
    
 };
 
 &sram0 {
     reg = <0x20000000 DT_SIZE_K(128)>;
 };
 
 &flash0 {
     reg = <0x0 DT_SIZE_K(192)>;
 };
 