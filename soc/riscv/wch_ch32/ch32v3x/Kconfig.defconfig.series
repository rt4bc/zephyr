## soc/riscv/wch_ch32/ch32v3x/Kconfig.defconfig.series
```kconfig
# Copyright (c)
# SPDX-License-Identifier: Apache-2.0

if SOC_SERIES_CH32V3X

config SOC_SERIES
	default "ch32v3x"

config NUM_IRQS
	# must be >= the highest interrupt number used
	default 88

config SYS_CLOCK_HW_CYCLES_PER_SEC
	# a 64-bit up/downcounter (SysTick) that supports HCLK or HCLK/8 as the time base,
	# has a higher priority and can be used for time base after calibration
	# The CPU frequency is set to the maximum value of 144MHz by default.
	default 18000000

#config PINCTRL
#	default y

#config RESET
#	default y

config CLOCK_CONTROL
	default y

source "soc/riscv/wch_ch32/ch32v3x/Kconfig.defconfig.ch32v3*"

endif # SOC_SERIES_CH32V3X
```

## soc/riscv/wch_ch32/ch32v3x/Kconfig.series
```kconfig
# CH32V3X SOC implementation
# Copyright (c)
# SPDX-License-Identifier: Apache-2.0

config SOC_SERIES_CH32V3X
	bool "CH32V3X"
    select RISCV
    select RISCV_GP
    select RISCV_ISA_RV32I
	select RISCV_ISA_EXT_M
	select RISCV_ISA_EXT_A
	select RISCV_ISA_EXT_C
    select RISCV_ISA_EXT_F
	select RISCV_ISA_EXT_ZICSR
	select RISCV_ISA_EXT_ZIFENCEI
    select SOC_FAMILY_CH32
    select HAS_CH32_HAL
	#select RISCV_PMP
    #select RISCV_PRIVILEGED
    #select RISCV_VECTORED_MODE
    select INCLUDE_RESET_VECTOR
    
```

## soc/riscv/wch_ch32/ch32v3x/Kconfig.soc
```kconfig
# Copyright (c)
# SPDX-License-Identifier: Apache-2.0

choice
	prompt "CH32 MCU Selection"
	depends on SOC_SERIES_CH32V3X

config SOC_CH32V303
	bool "ch32v303"

config SOC_CH32V305
	bool "ch32v305"

config SOC_CH32V307
	bool "ch32v307"

endchoice
```
